## boards/shields/redox/Kconfig.shield
```kconfig
# Copyright (c) 2021 The ZMK Contributors
# SPDX-License-Identifier: MIT
config SHIELD_REDOX_LEFT_STUDIO
    def_bool $(shields_list_contains,redox_left_studio)

config SHIELD_REDOX_RIGHT
    def_bool $(shields_list_contains,redox_right)
```
